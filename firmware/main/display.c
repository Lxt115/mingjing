#include "display.h"
#include "zh_font.h"
#include "esp_log.h"
#include <string.h>

static const char *TAG = "display";

static i2c_master_dev_handle_t s_dev = NULL;
static uint8_t s_buffer[DISPLAY_WIDTH * DISPLAY_HEIGHT / 8];

/* Scroll state */
static int s_scroll_x = 0;
static int s_total_width = 0;
static char s_last_message[512] = "";

/* ── 8x8 Bitmap Font (ASCII 0x20-0x7E) ── */
static const uint8_t font8x8[95][8] = {
    {0x00,0x00,0x00,0x00,0x00,0x00,0x00,0x00}, /*   */
    {0x18,0x3C,0x3C,0x18,0x18,0x00,0x18,0x00}, /* ! */
    {0x66,0x66,0x24,0x00,0x00,0x00,0x00,0x00}, /* " */
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    {0x76,0xDC,0x00,0x00,0x00,0x00,0x00,0x00}, /* ~ */
};

/* ── SSD1306 I2C helpers ── */

static esp_err_t ssd1306_write_cmd(uint8_t cmd)
{
    uint8_t buf[2] = {0x00, cmd};
    return i2c_master_transmit(s_dev, buf, 2, 10);
}

static esp_err_t ssd1306_write_data(const uint8_t *data, size_t len)
{
    for (size_t off = 0; off < len;) {
        size_t chunk = len - off;
        if (chunk > 128) chunk = 128;
        uint8_t buf[129];
        buf[0] = 0x40;
        memcpy(buf + 1, data + off, chunk);
        esp_err_t ret = i2c_master_transmit(s_dev, buf, chunk + 1, 10);
        if (ret != ESP_OK) return ret;
        off += chunk;
    }
    return ESP_OK;
}

static void display_flush(void)
{
    ssd1306_write_cmd(0x20); ssd1306_write_cmd(0x00);
    ssd1306_write_cmd(0x21); ssd1306_write_cmd(0); ssd1306_write_cmd(127);
    ssd1306_write_cmd(0x22); ssd1306_write_cmd(0); ssd1306_write_cmd(7);
    ssd1306_write_data(s_buffer, sizeof(s_buffer));
}

/* ── Pixel-level draw (sets a single pixel in the buffer) ── */

static inline void draw_pixel(int x, int y)
{
    if (x < 0 || x >= DISPLAY_WIDTH || y < 0 || y >= DISPLAY_HEIGHT) return;
    s_buffer[(y / 8) * DISPLAY_WIDTH + x] |= (1 << (y % 8));
}

/* ── Draw 8x8 ASCII glyph at pixel (x, y) ── */

static void draw_ascii_glyph(int x, int y, char ch)
{
    if (ch < 0x20 || ch > 0x7E) ch = ' ';
    const uint8_t *glyph = font8x8[ch - 0x20];
    for (int row = 0; row < 8; row++) {
        uint8_t line = glyph[row];
        for (int col = 0; col < 8; col++) {
            if (line & (1 << (7 - col))) {
                draw_pixel(x + col, y + row);
            }
        }
    }
}

/* ── Draw 16x16 Chinese glyph at pixel (x, y) ── */

static void draw_zh_glyph(int x, int y, const uint8_t *bitmap)
{
    for (int row = 0; row < 16; row++) {
        for (int col = 0; col < 16; col++) {
            if (bitmap[row * 2 + col / 8] & (1 << (7 - (col % 8)))) {
                draw_pixel(x + col, y + row);
            }
        }
    }
}

/* ── UTF-8 decode: returns codepoint and advances *s by the number of bytes consumed ── */

static uint32_t utf8_decode(const uint8_t **s)
{
    const uint8_t *p = *s;
    uint32_t cp;
    uint8_t c = *p;

    if (c < 0x80) {
        (*s)++;
        return c;
    }

    if ((c & 0xE0) == 0xC0) {
        cp = ((c & 0x1F) << 6) | (p[1] & 0x3F);
        *s += 2;
        return cp;
    }

    if ((c & 0xF0) == 0xE0) {
        cp = ((c & 0x0F) << 12) | ((p[1] & 0x3F) << 6) | (p[2] & 0x3F);
        *s += 3;
        return cp;
    }

    if ((c & 0xF8) == 0xF0) {
        cp = ((c & 0x07) << 18) | ((p[1] & 0x3F) << 12) | ((p[2] & 0x3F) << 6) | (p[3] & 0x3F);
        *s += 4;
        return cp;
    }

    // Invalid, skip byte
    (*s)++;
    return '?';
}

/* ── Binary search the font index for a codepoint ── */

static const uint8_t *zh_font_lookup(uint32_t codepoint)
{
    int lo = 0, hi = ZH_FONT_COUNT - 1;
    while (lo <= hi) {
        int mid = (lo + hi) / 2;
        uint16_t cp = zh_font_index[mid].codepoint;
        if (cp == codepoint) {
            return &zh_font_bitmap[zh_font_index[mid].offset];
        } else if (cp < codepoint) {
            lo = mid + 1;
        } else {
            hi = mid - 1;
        }
    }
    return NULL; // Character not found in font
}

/* ── Fullwidth punctuation → ASCII fallback table ── */

static char fullwidth_to_ascii(uint32_t cp)
{
    switch (cp) {
        case 0xFF08: return '(';   // （
        case 0xFF09: return ')';   // ）
        case 0xFF0C: return ',';   // ，
        case 0x3001: return ',';   // 、
        case 0x3002: return '.';   // 。
        case 0xFF01: return '!';   // ！
        case 0xFF1F: return '?';   // ？
        case 0xFF1A: return ':';   // ：
        case 0xFF1B: return ';';   // ；
        case 0x201C: return '"';   // "
        case 0x201D: return '"';   // "
        case 0x2018: return '\'';  // '
        case 0x2019: return '\'';  // '
        default:    return 0;
    }
}

/* ── Measure total pixel width of a UTF-8 string (without rendering) ── */

static int measure_text_width(const char *str)
{
    if (!str) return 0;
    int width = 0;
    const uint8_t *p = (const uint8_t *)str;
    while (*p) {
        uint32_t cp = utf8_decode(&p);
        if (cp < 0x80) {
            width += 8;
        } else {
            const uint8_t *bmp = zh_font_lookup(cp);
            if (bmp) {
                width += 16;
            } else if (fullwidth_to_ascii(cp)) {
                width += 8;   // fallback to ASCII width
            } else {
                width += 8;   // '?' width
            }
        }
    }
    return width;
}

/* ── Render UTF-8 string with scroll offset; returns total pixel width ── */

static int render_utf8(int base_x, int base_y, const char *str, int scroll)
{
    if (!str) return 0;
    int x = base_x - scroll;
    int y = base_y;
    int max_x = base_x;
    const uint8_t *p = (const uint8_t *)str;

    while (*p) {
        uint32_t cp = utf8_decode(&p);
        if (cp < 0x80) {
            // ASCII: center vertically in the 16px text row
            draw_ascii_glyph(x, y + 4, (char)cp);
            x += 8;
        } else {
            const uint8_t *bmp = zh_font_lookup(cp);
            if (bmp) {
                // Chinese: 16x16 glyph
                draw_zh_glyph(x, y, bmp);
                x += 16;
            } else {
                // Try fullwidth→ASCII fallback
                char ascii = fullwidth_to_ascii(cp);
                if (ascii) {
                    draw_ascii_glyph(x, y + 4, ascii);
                    x += 8;
                } else {
                    // Unknown: fallback to '?'
                    draw_ascii_glyph(x, y + 4, '?');
                    x += 8;
                }
            }
        }
        if (x > max_x) max_x = x;
    }

    return max_x - base_x + scroll;
}

/* ── Public API ── */

void display_init(i2c_master_bus_handle_t i2c_bus)
{
    i2c_device_config_t dev_cfg = {
        .dev_addr_length = I2C_ADDR_BIT_LEN_7,
        .device_address = DISPLAY_I2C_ADDR,
        .scl_speed_hz = 400000,
    };
    esp_err_t ret = i2c_master_bus_add_device(i2c_bus, &dev_cfg, &s_dev);
    if (ret != ESP_OK) {
        ESP_LOGE(TAG, "Failed to add SSD1306 device: %s", esp_err_to_name(ret));
        return;
    }

    ssd1306_write_cmd(0xAE);
    ssd1306_write_cmd(0xD5); ssd1306_write_cmd(0x80);
    ssd1306_write_cmd(0xA8); ssd1306_write_cmd(0x3F);
    ssd1306_write_cmd(0xD3); ssd1306_write_cmd(0x00);
    ssd1306_write_cmd(0x40);
    ssd1306_write_cmd(0x8D); ssd1306_write_cmd(0x14);
    ssd1306_write_cmd(0x20); ssd1306_write_cmd(0x00);
    ssd1306_write_cmd(0xA1);
    ssd1306_write_cmd(0xC8);
    ssd1306_write_cmd(0xDA); ssd1306_write_cmd(0x12);
    ssd1306_write_cmd(0x81); ssd1306_write_cmd(0xCF);
    ssd1306_write_cmd(0xD9); ssd1306_write_cmd(0xF1);
    ssd1306_write_cmd(0xDB); ssd1306_write_cmd(0x40);
    ssd1306_write_cmd(0xA4);
    ssd1306_write_cmd(0xA6);
    ssd1306_write_cmd(0x2E);
    ssd1306_write_cmd(0xAF);

    ESP_LOGI(TAG, "SSD1306 initialized at 0x%02X", DISPLAY_I2C_ADDR);
    display_clear();
}

void display_show(const char *status, const char *message)
{
    memset(s_buffer, 0, sizeof(s_buffer));

    // ── Line 0: status (8x8 ASCII, y=0) ──
    if (status) {
        const char *p = status;
        int x = 0;
        while (*p && x < DISPLAY_WIDTH - 8) {
            draw_ascii_glyph(x, 0, *p);
            p++;
            x += 8;
        }
    }

    // ── Line 1: separator (dotted, y=8) ──
    for (int i = 0; i < DISPLAY_WIDTH; i += 4) {
        draw_pixel(i, 8);
        draw_pixel(i + 1, 8);
    }

    // ── Lines 2-7: message area (y=16 to y=63, 48px) ──
    if (message) {
        // Check if message changed → reset scroll
        if (strcmp(message, s_last_message) != 0) {
            strncpy(s_last_message, message, sizeof(s_last_message) - 1);
            s_last_message[sizeof(s_last_message) - 1] = '\0';
            s_scroll_x = 0;
            s_total_width = measure_text_width(message);
        }

        // Render with scroll offset
        render_utf8(0, 16, message, s_scroll_x);
    }

    display_flush();
}

void display_tick(void)
{
    if (s_total_width <= DISPLAY_WIDTH) return;
    if (s_last_message[0] == '\0') return;

    // Advance scroll by 2 pixels
    s_scroll_x += 2;

    // Reset when fully scrolled past (with a bit of gap)
    if (s_scroll_x > s_total_width + 32) {
        s_scroll_x = -DISPLAY_WIDTH;
    }

    // Redraw just the message area
    // (top 2 rows stay, we redraw from y=16)
    memset(s_buffer + (DISPLAY_HEIGHT / 8 - 6) * DISPLAY_WIDTH, 0, 6 * DISPLAY_WIDTH);

    if (s_last_message[0]) {
        render_utf8(0, 16, s_last_message, s_scroll_x);
    }
    display_flush();
}

void display_clear(void)
{
    memset(s_buffer, 0, sizeof(s_buffer));
    display_flush();
}

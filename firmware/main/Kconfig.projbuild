## firmware/main/Kconfig.projbuild
```kconfig
menu "Aidoll Device Configuration"

# WiFi 凭据现在通过 NVS + 网页配网管理，不再需要编译期配置
# 设备首次启动会自动进入 AP 配网模式 (SSID: Aidoll-Config)

config DEVICE_ID
    string "Device ID (UUID)"
    help
        Unique identifier for this device. Used for the WebSocket
        device management channel (/ws/device/{id}).

config DEVICE_AGENT_ID
    string "Agent ID"
    help
        The UUID of the AI agent to connect to.

config DEVICE_SERVER_HOST
    string "Server Host"
    help
        IP address or hostname of the backend server.

config DEVICE_SERVER_PORT
    string "Server Port"
    default "8000"
    help
        Port number of the backend server (WebSocket).

endmenu
```

## firmware/sdkconfig.defaults
```kconfig
CONFIG_IDF_TARGET="esp32c3"
CONFIG_ESPTOOLPY_FLASHSIZE_4MB=y
CONFIG_ESPTOOLPY_FLASHSIZE="4MB"

CONFIG_PARTITION_TABLE_CUSTOM=y
CONFIG_PARTITION_TABLE_CUSTOM_FILENAME="partitions.csv"
CONFIG_PARTITION_TABLE_FILENAME="partitions.csv"

CONFIG_DEVICE_WIFI_SSID="502"
CONFIG_DEVICE_WIFI_PASSWORD="20010329"

CONFIG_ESP_WIFI_STATIC_RX_BUFFER_NUM=8
CONFIG_ESP_WIFI_DYNAMIC_RX_BUFFER_NUM=32
CONFIG_ESP_WIFI_TX_BUFFER_TYPE=1
CONFIG_ESP_WIFI_DYNAMIC_TX_BUFFER_NUM=32

CONFIG_LWIP_MAX_SOCKETS=8
CONFIG_LWIP_SO_RCVBUF=y

CONFIG_FREERTOS_HZ=1000

CONFIG_COMPILER_OPTIMIZATION_SIZE=y

CONFIG_DEVICE_SERVER_HOST="192.168.1.28"
CONFIG_DEVICE_SERVER_PORT="8000"
CONFIG_DEVICE_AGENT_ID="b96d105e-1d43-4c7a-824d-d8e715bb19c8"
```
